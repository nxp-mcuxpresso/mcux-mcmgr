## Kconfig
```kconfig
#
# Copyright 2024-2025 NXP
#
# SPDX-License-Identifier: BSD-3-Clause
#

menuconfig MCUX_COMPONENT_middleware.multicore.mcmgr
    bool "Multicore Manager mcmgr"
    help
        This option will enable Multicore Manager Middleware Component

if MCUX_COMPONENT_middleware.multicore.mcmgr

rsource "./Kconfig.platform"

    config MCMGR_BUSY_POLL_COUNT
        int "Maximum polling iterations for MCMGR waiting loops (0 means poll indefinitely)"
        default 0
        help
          This parameter defines the maximum number of iterations for any polling loop
          in the MCMGR code before timing out and returning an error.

          It applies to all waiting loops in MCMGR, such as waiting for a core to start,
          waiting for a response from another core, or waiting for a resource to become
          available.

          This is a count of loop iterations, not a time-based value.

          If set to 0, polling loops will continue indefinitely until their exit condition
          is met, which could potentially cause the system to hang if a core becomes
          unresponsive.

endif
```

## Kconfig.platform
```kconfig
#
# Copyright 2024 NXP
#
# SPDX-License-Identifier: BSD-3-Clause
#

config MCUX_COMPONENT_middleware.multicore.mcmgr.imxrt700
    bool
    default y
    select MCUX_COMPONENT_driver.mu1
    depends on MCUX_HW_DEVICE_MIMXRT798S || MCUX_HW_DEVICE_MIMXRT758S || \
               MCUX_HW_DEVICE_MIMXRT735S
    help
        "Multicore Manger Porting Layer for i.MX RT700"

config MCUX_COMPONENT_middleware.multicore.mcmgr.imxrt1160
    bool
    default y
    select MCUX_COMPONENT_driver.mu
    depends on MCUX_HW_DEVICE_MIMXRT1165 || MCUX_HW_DEVICE_MIMXRT1166
    help
        "Multicore Manger Porting Layer for i.MX RT1160"

config MCUX_COMPONENT_middleware.multicore.mcmgr.imxrt1170
    bool
    default y
    select MCUX_COMPONENT_driver.mu
    depends on MCUX_HW_DEVICE_MIMXRT1173 || MCUX_HW_DEVICE_MIMXRT1175 || \
               MCUX_HW_DEVICE_MIMXRT1176
    help
        "Multicore Manger Porting Layer for i.MX RT1170"

config MCUX_COMPONENT_middleware.multicore.mcmgr.imxrt1180
    bool
    default y
    select MCUX_COMPONENT_driver.mu1
    depends on MCUX_HW_DEVICE_MIMXRT1187 || MCUX_HW_DEVICE_MIMXRT1189 || \
               MCUX_HW_DEVICE_MIMXRT1189A
    help
        "Multicore Manger Porting Layer for i.MX RT1180"

config MCUX_COMPONENT_middleware.multicore.mcmgr.k32l3a6
    bool
    default y
    select MCUX_COMPONENT_driver.mu
    depends on MCUX_HW_DEVICE_K32L3A60
    help
        "Multicore Manger Porting Layer for FRDM-K32L3A6"

config MCUX_COMPONENT_middleware.multicore.mcmgr.k32w1
    bool
    default y
    select MCUX_COMPONENT_driver.imu
    depends on MCUX_HW_DEVICE_K32W1480
    help
        "Multicore Manger Porting Layer for FRDM-K32W1"

config MCUX_COMPONENT_middleware.multicore.mcmgr.kw45b41
    bool
    default y
    select MCUX_COMPONENT_driver.imu
    depends on MCUX_HW_DEVICE_KW45B41Z52 || MCUX_HW_DEVICE_KW45B41Z53 || \
               MCUX_HW_DEVICE_KW45B41Z82 || MCUX_HW_DEVICE_KW45B41Z83 || \
               MCUX_HW_DEVICE_KW45B41Z83_NBU
    help
        "Multicore Manger Porting Layer for KW45B41Z-EVK"

config MCUX_COMPONENT_middleware.multicore.mcmgr.kw47b42
    bool
    default y
    select MCUX_COMPONENT_driver.imu
    depends on MCUX_HW_DEVICE_KW47B42Z83 || MCUX_HW_DEVICE_KW47B42Z96 || \
               MCUX_HW_DEVICE_KW47B42Z97 || MCUX_HW_DEVICE_KW47B42ZB2 || \
               MCUX_HW_DEVICE_KW47B42ZB3 || MCUX_HW_DEVICE_KW47B42ZB6 || \
               MCUX_HW_DEVICE_KW47B42ZB7 || MCUX_HW_DEVICE_KW47Z42082 || \
               MCUX_HW_DEVICE_KW47Z42092 || MCUX_HW_DEVICE_KW47Z420B2 || \
               MCUX_HW_DEVICE_KW47Z420B3
    help
        "Multicore Manger Porting Layer for KW47B42-EVK"

config MCUX_COMPONENT_middleware.multicore.mcmgr.kw43b43
    bool
    default y
    select MCUX_COMPONENT_driver.mu1
    depends on MCUX_HW_DEVICE_KW43B43ZC7 || MCUX_HW_DEVICE_KW43B43ZC7_NBU
    help
        "Multicore Manger Porting Layer for KW43B43-EVK"

config MCUX_COMPONENT_middleware.multicore.mcmgr.lpc55s69
    bool
    default y
    select MCUX_COMPONENT_driver.mailbox
    depends on MCUX_HW_DEVICE_LPC55S66 || MCUX_HW_DEVICE_LPC55S69
    help
        "Multicore Manger Porting Layer for LPCXpresso55S69"

config MCUX_COMPONENT_middleware.multicore.mcmgr.lpc54114
    bool
    default y
    select MCUX_COMPONENT_driver.mailbox
    depends on MCUX_HW_DEVICE_LPC54102 || MCUX_HW_DEVICE_LPC54114
    help
        "Multicore Manger Porting Layer for LPCXpresso54114"

config MCUX_COMPONENT_middleware.multicore.mcmgr.mcxnx4x
    bool
    default y
    select MCUX_COMPONENT_driver.mailbox
    depends on MCUX_HW_DEVICE_MCXN546 || MCUX_HW_DEVICE_MCXN547 || \
               MCUX_HW_DEVICE_MCXN947 || MCUX_HW_DEVICE_MCXN946
    help
        "Multicore Manger Porting Layer for MCX-N94X-N54X"

config MCUX_COMPONENT_middleware.multicore.mcmgr.mcxw716
    bool
    default y
    select MCUX_COMPONENT_driver.imu
    depends on MCUX_HW_DEVICE_MCXW716A || MCUX_HW_DEVICE_MCXW716C
    help
        "Multicore Manger Porting Layer for MCX-W716"

config MCUX_COMPONENT_middleware.multicore.mcmgr.mcxw727
    bool
    default y
    select MCUX_COMPONENT_driver.imu
    depends on MCUX_HW_DEVICE_MCXW727A || MCUX_HW_DEVICE_MCXW727C || \
               MCUX_HW_DEVICE_MCXW727D
    help
        "Multicore Manger Porting Layer for MCX-W727"
```

## tests/Kconfig
```kconfig
#
# Copyright 2024 NXP
#
# SPDX-License-Identifier: BSD-3-Clause

rsource "../../../../Kconfig.mcuxpresso"

menu "MCMgr Testing Config"

config MCMGR_TEST_ENABLE
    bool "MCMgr Enable Test"
    default y
    help
        "Set this to enable testing."

endmenu
```
